## main/Kconfig.projbuild
```kconfig
menu "PicoNano OTA"
config PN_DEVICE_OTA
    bool "Enable signed Gitee Wi-Fi OTA"
    depends on BOOTLOADER_APP_ROLLBACK_ENABLE
    select MBEDTLS_CERTIFICATE_BUNDLE
    default n
    help
        Enable only after provisioning the release public key and qualifying the
        initial USB migration. Normal OTA never writes the bootloader or NVS.
config PN_OTA_PUBLIC_KEY_HEX
    string "Uncompressed ECDSA P-256 public key (130 hexadecimal characters)"
    default ""
    help
        Public key only: 04 followed by the 32-byte X and Y coordinates.
        An empty or malformed key disables OTA. Never put the private key here.
endmenu
menu "PicoNano diagnostics"
config PN_PROFILE
    bool "Log memory and phase timing"
    default n
    help
        Emit owner phase timing, pool accounting and real heap snapshots.
        Serial logging changes timing; use dedicated diagnostic runs.
config PN_TEST_CONSOLE
    bool "Serial test console (diagnostic images only)"
    default n
    help
        Accept line commands on USB Serial/JTAG that inject synthetic touch samples,
        a power short press, status queries and shown-frame screenshots, and report
        every display job. Anyone with USB access can drive the device, and logging
        changes timing, so never enable this in a product or release image.
config PN_WAKE_TRACE
    bool "Deferred wake trace (diagnostic images only)"
    default n
    help
        Retain an owner-only wake snapshot and small internal A/B checkpoints for replay after restart.
        Does not change sleep or media validation; never enable in release images.
config PN_DIAG_NO_AUTO_LOCK
    bool "Disable idle auto-lock (diagnostic images only)"
    default n
    help
        Skip the five-minute idle lock and its sleep so long serial test runs keep USB alive.
        The power key still locks and wakes. Never enable this in product or release images.
config PN_DIAG_NO_LOCK_SLEEP
    bool "Poll instead of light-sleeping while locked (diagnostic images only)"
    depends on PN_TEST_CONSOLE
    default n
    help
        Keep the lock-screen wait loop and PMU checks but replace light sleep with a 500 ms delay,
        so USB serial stays alive and the console power command can also wake. Hardware sleep and
        wake are then not exercised; never enable this in product or release images.
config PN_UI_FEEDBACK
    bool "Qualify local press feedback on the panel"
    default n
    help
        Use the existing FOLLOW DU table only for bounded reversible control feedback.
        Keep disabled until press/restore ghosting, gray restoration and underruns
        have been qualified on the actual panel. Ordinary content stays GL16/GC16.
config PN_UI_FOLLOW
    bool "Qualify continuous font-list scrolling on the panel"
    default n
    help
        Use the original FOLLOW phase and black7/white8 counts for binary list motion.
        Enable only in a panel qualification image. Gray normalization, settling,
        failed scans and navigation/media/USB/sleep barriers require device testing.
endmenu
menu "PicoNano power"
config PN_POWER_DFS
    bool "Dynamic CPU frequency while idle"
    depends on PM_ENABLE
    default y
    help
        Product, display and wireless-session owners hold a max-frequency lock while working;
        idle drops to PN_POWER_MIN_MHZ. Automatic light sleep follows PN_POWER_LIGHT_SLEEP
        and the peripheral/session locks; enabling it is not a power or wakeup measurement.
config PN_POWER_MIN_MHZ
    int "Idle CPU frequency (MHz)"
    depends on PN_POWER_DFS
    range 80 240
    default 80
    help
        Keep at least 80 MHz so the CPU stays on the PLL and MSPI 120 MHz timing is not switched.
config PN_POWER_LIGHT_SLEEP
    bool "Automatic light sleep when idle"
    depends on PN_POWER_DFS && FREERTOS_USE_TICKLESS_IDLE
    default y
    help
        Let the tickless idle task enter light sleep when no owner holds a lock. Work, panel scans,
        powered panel rails, wireless sessions and SD/I2C transactions keep the chip awake.
        Idle touch input is sampled by a 30 ms timer, so no level-triggered GPIO wake is needed.
endmenu
```
